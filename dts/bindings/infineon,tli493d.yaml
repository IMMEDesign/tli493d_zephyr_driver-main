## dts/bindings/infineon,tli493d.yaml
```yaml
# Copyright (c) 2023 Andriy Gelman <andriy.gelman@gmail.com>
# SPDX-License-Identifier: Apache-2.0

description: Infineon TLI493D hall sensor

compatible: "infineon,tli493d"

include: [i2c-device.yaml, sensor-device.yaml]
```

## sensor/tli493d/Kconfig
```kconfig
config TLI493D
	bool "TLI493D hall effect sensor driver"
	default y
	depends on DT_HAS_INFINEON_TLI493D_ENABLED
	select I2C
	help
	  Enable the TLI493D hall effect sensor driver.
```
